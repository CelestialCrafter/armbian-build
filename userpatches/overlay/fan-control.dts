/* taken from https://forum.radxa.com/t/guide-how-to-make-the-rock-5b-fan-work-properly-joshua-rieks-ubuntu-24-04/20836/2 */

/dts-v1/;
/plugin/;
/ {
	fragment@0 {
		target = <&fan0>;
		__overlay__ {
			cooling-levels = <146 146 146 146 146 146 149 149 151>;
		};
	};
};
